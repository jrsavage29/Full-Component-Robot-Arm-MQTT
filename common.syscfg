/**
 * @cliArgs --board "/ti/boards/CC3220SF_LAUNCHXL" --product "simplelink_cc32xx_sdk@4_10_00_07"
 * @versions {"data":"2020021217","timestamp":"2020021217","tool":"1.4.0+1234","templates":"2020021217"}
 */

/**
 * Import the modules used in this configuration.
 */
const DriverLib      = scripting.addModule("/ti/devices/DriverLib");
const Display        = scripting.addModule("/ti/display/Display");
const Display1       = Display.addInstance();
const Board          = scripting.addModule("/ti/drivers/Board");
const Crypto         = scripting.addModule("/ti/drivers/Crypto");
const Crypto1        = Crypto.addInstance();
const DMA            = scripting.addModule("/ti/drivers/DMA");
const GPIO           = scripting.addModule("/ti/drivers/GPIO");
const GPIO1          = GPIO.addInstance();
const GPIO2          = GPIO.addInstance();
const GPIO3          = GPIO.addInstance();
const GPIO4          = GPIO.addInstance();
const GPIO5          = GPIO.addInstance();
const GPIO6          = GPIO.addInstance();
const GPIO7          = GPIO.addInstance();
const GPIO8          = GPIO.addInstance();
const PWM            = scripting.addModule("/ti/drivers/PWM", {}, false);
const PWM1           = PWM.addInstance();
const PWM2           = PWM.addInstance();
const PWM3           = PWM.addInstance();
const PWM4           = PWM.addInstance();
const Power          = scripting.addModule("/ti/drivers/Power");
const SPI            = scripting.addModule("/ti/drivers/SPI");
const SPI1           = SPI.addInstance();
const Timer          = scripting.addModule("/ti/drivers/Timer");
const Timer1         = Timer.addInstance();
const Watchdog       = scripting.addModule("/ti/drivers/Watchdog");
const Watchdog1      = Watchdog.addInstance();
const SimpleLinkWifi = scripting.addModule("/ti/drivers/net/wifi/SimpleLinkWifi");
const SlNet          = scripting.addModule("/ti/net/SlNet");
const SlNet1         = SlNet.addInstance();

/**
 * Write custom configuration values to the imported modules.
 */
Display1.$name                          = "CONFIG_Display_0";
Display1.$hardware                      = system.deviceData.board.components.XDS110UART;
Display1.uart.$name                     = "CONFIG_UART_0";
Display1.uart.useDMA                    = true;
Display1.uart.uart.$name                = "MyUART1";
Display1.uart.uart.$assign              = "UART0";
Display1.uart.uart.txPin.$assign        = "GP01";
Display1.uart.uart.rxPin.$assign        = "GP02";
Display1.uart.uart.txDmaChannel.$assign = "UDMA_CH9";
Display1.uart.uart.rxDmaChannel.$assign = "UDMA_CH8";

Crypto1.$name = "CONFIG_Crypto_0";

GPIO1.mode            = "Output";
GPIO1.$name           = "CONFIG_GPIO_P15_BIT_1";
GPIO1.gpioPin.$assign = "boosterpack.11";

GPIO2.mode            = "Output";
GPIO2.$name           = "CONFIG_GPIO_P63_BIT_2";
GPIO2.gpioPin.$assign = "boosterpack.27";

GPIO3.mode            = "Output";
GPIO3.$name           = "CONFIG_GPIO_P50_BIT_3";
GPIO3.gpioPin.$assign = "boosterpack.30";

GPIO4.mode            = "Output";
GPIO4.$name           = "CONFIG_GPIO_P53_BIT_4";
GPIO4.gpioPin.$assign = "boosterpack.28";

GPIO5.mode            = "Output";
GPIO5.$name           = "CONFIG_GPIO_P18_BIT_5";
GPIO5.gpioPin.$assign = "boosterpack.19";

GPIO6.mode            = "Output";
GPIO6.$name           = "CONFIG_GPIO_P03_BIT_6";
GPIO6.gpioPin.$assign = "boosterpack.4";

GPIO7.mode            = "Output";
GPIO7.$name           = "CONFIG_GPIO_P61_BIT_7";
GPIO7.gpioPin.$assign = "boosterpack.5";

GPIO8.$name           = "CONFIG_GPIO_P62_BIT_8";
GPIO8.mode            = "Output";
GPIO8.gpioPin.$assign = "boosterpack.8";

PWM1.$name                = "CONFIG_PWM_0";
PWM1.timer.$name          = "MyTimer1";
PWM1.timer.pwmPin.$assign = "boosterpack.13";

PWM2.$name                = "CONFIG_PWM_1";
PWM2.timer.$name          = "MyTimer1";
PWM2.timer.pwmPin.$assign = "boosterpack.9";

PWM3.$name                = "CONFIG_PWM_2";
PWM3.timer.$name          = "MyTimer1";
PWM3.timer.pwmPin.$assign = "boosterpack.10";

PWM4.$name                = "CONFIG_PWM_3";
PWM4.timer.$name          = "MyTimer1";
PWM4.timer.pwmPin.$assign = "boosterpack.29";

Power.ioRetentionShutdown = ["GRP_1"];
Power.parkPins.$name      = "ti_drivers_power_PowerCC32XXPins0";

SPI1.$name                    = "CONFIG_SPI_0";
SPI1.mode                     = "Four Pin SS Active Low";
SPI1.defaultTxBufferValue     = "0";
SPI1.spi.$name                = "MySPI1";
SPI1.spi.$assign              = "SPI0";
SPI1.spi.sclkPin.$assign      = "boosterpack.7";
SPI1.spi.misoPin.$assign      = "boosterpack.14";
SPI1.spi.mosiPin.$assign      = "boosterpack.15";
SPI1.spi.ssPin.$assign        = "boosterpack.18";
SPI1.spi.dmaRxChannel.$assign = "UDMA_CH6";
SPI1.spi.dmaTxChannel.$assign = "UDMA_CH7";

Timer1.$name         = "CONFIG_TIMER_0";
Timer1.timerType     = "32 Bits";
Timer1.timer.$name   = "MyTimer1";
Timer1.timer.$assign = "Timer0";

Watchdog1.$name            = "CONFIG_WATCHDOG_0";
Watchdog1.watchdog.$name   = "MyWATCHDOG1";
Watchdog1.watchdog.$assign = "WATCHDOG0";

SlNet1.$name  = "CONFIG_SLNET";
SlNet1.ifName = "CC32xx";

/**
 * Pinmux solution for unlocked pins/peripherals. This ensures that minor changes to the automatic solver in a future
 * version of the tool will not impact the pinmux you originally saw.  These lines can be completely deleted in order to
 * re-solve from scratch.
 */
PWM1.timer.$suggestSolution = "Timer1";
PWM2.timer.$suggestSolution = "Timer3";
PWM3.timer.$suggestSolution = "Timer3";
PWM4.timer.$suggestSolution = "Timer2";
